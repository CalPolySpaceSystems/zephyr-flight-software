## CMakeLists.txt
```
include($ENV{ZEPHYR_BASE}/cmake/app/boilerplate.cmake NO_POLICY_SCOPE)
project(NONE)

target_sources(app PRIVATE src/main.c)


# The external static library that we are linking with does not know
# how to build for this platform so we export all the flags used in
# this zephyr build to the external build system.
#
# Other external build systems may be self-contained enough that they
# do not need any build information from zephyr. Or they may be
# incompatible with certain zephyr options and need them to be
# filtered out.
zephyr_get_include_directories_for_lang_as_string(       C includes)
zephyr_get_system_include_directories_for_lang_as_string(C system_includes)
zephyr_get_compile_definitions_for_lang_as_string(       C definitions)
zephyr_get_compile_options_for_lang_as_string(           C options)

set(external_project_cflags
  "${includes} ${definitions} ${options} ${system_includes}"
  )

include(ExternalProject)

# Add an external project to be able download and build the third
# party library. In this case downloading is not necessary as it has
# been committed to the repository.
set(ms56xx_src_dir   ${CMAKE_CURRENT_SOURCE_DIR}/ms56xx)
set(ms56xx_build_dir ${CMAKE_CURRENT_BINARY_DIR}/ms56xx)

set(ms56xx_LIB_DIR     ${ms56xx_build_dir}/lib)
set(ms56xx_INCLUDE_DIR ${ms56xx_src_dir}/include)

ExternalProject_Add(
  ms56xx_project                 # Name for custom target
  PREFIX     ${ms56xx_build_dir} # Root dir for entire project
  SOURCE_DIR ${ms56xx_src_dir}
  BINARY_DIR ${ms56xx_src_dir} # This particular build system is invoked from the root
  CONFIGURE_COMMAND ""    # Skip configuring the project, e.g. with autoconf
  BUILD_COMMAND
  make
  PREFIX=${ms56xx_build_dir}
  CC=${CMAKE_C_COMPILER}
  CFLAGS=${external_project_cflags}
  INSTALL_COMMAND ""      # This particular build system has no install command
  BUILD_BYPRODUCTS ${ms56xx_LIB_DIR}/libms56xx.a
  )

# Create a wrapper CMake library that our app can link with
add_library(ms56xx_lib STATIC IMPORTED GLOBAL)
add_dependencies(
  ms56xx_lib
  ms56xx_project
  )
set_target_properties(ms56xx_lib PROPERTIES IMPORTED_LOCATION             ${ms56xx_LIB_DIR}/libms56xx.a)
set_target_properties(ms56xx_lib PROPERTIES INTERFACE_INCLUDE_DIRECTORIES ${ms56xx_INCLUDE_DIR})

target_link_libraries(app ms56xx_lib)
```

## prj.conf
```kconfig
CONFIG_STDOUT_CONSOLE=y


CONFIG_NEWLIB_LIBC=y
CONFIG_PRINTK=y
CONFIG_HEAP_MEM_POOL_SIZE=512
CONFIG_ASSERT=y
CONFIG_GPIO=y
CONFIG_I2C=y
```

## src/main.c
```c
/*
 * Copyright (c) 2017 Linaro Limited
 *
 * SPDX-License-Identifier: Apache-2.0
 */

#include <errno.h>
#include <zephyr.h>
#include <misc/printk.h>
#include <device.h>
#include <i2c.h>
#include <board.h>
#include <ms56xx.h>
#include <string.h>
#include <stdio.h>
#include <math.h>

#if defined(CONFIG_SOC_QUARK_SE_C1000_SS)
#define I2C_DEV CONFIG_I2C_SS_0_NAME
#else
#define I2C_DEV CONFIG_I2C_1_NAME
#endif

/* 1000 msec = 1 sec */

struct ms56xx_data baro;

void main(void)
{
	int rc;

	// Necessary Variables
	struct device *ms56xx_dev;

	// Init i2c
	ms56xx_dev = device_get_binding(I2C_DEV);

	rc = ms56xx_init(ms56xx_dev);
	
	//k_sleep(2000);

	while (1) {

		rc = ms56xx_prime(ms56xx_dev,MS56XX_TEMP);
		if(rc){
			printk("Prime Temp Error\n"); 
		}
		//printk("Temp Primed\n");
		k_sleep(10);

		rc = ms56xx_read_temperature(ms56xx_dev,&baro);
		if(rc){
			printk("Read Temp Error\n");
		}
		//printk("Temp Read\n");
		k_sleep(1);

		rc = ms56xx_prime(ms56xx_dev,MS56XX_PRESS);
		if(rc){
			printk("Prime Pressure Error\n");
		}

		//printk("Pressure Primed\n");
		k_sleep(10);

		rc = ms56xx_read_pressure(ms56xx_dev,&baro);
		if(rc){
			printk("Read Pressure Error\n");
		}
		//printk("Pressure Read\n");

		// Calculate altitude
		ms56xx_calc_altitude(&baro);

		// Convert values to integers
		int temp1 = (int32_t)(floor(baro.temperature));
		int press1 = (int32_t)(floor(baro.pressure));
		int alt1 = (int32_t)(floor(baro.altitude));

		int temp2 = (int32_t)floor(1000*(baro.temperature-temp1));
		int press2 = (int32_t)floor(1000*(baro.pressure-press1));
		int alt2  = (int32_t)floor(1000*(baro.altitude-alt1));

		// Print values
		printk("%d",temp1);
		printk(".");
		printk("%d",temp2);
		printk(", ");
		printk("%d",press1);
		printk(".");
		printk("%d",press2);
		printk(", ");
		printk("%d",alt1);
		printk(".");
		printk("%d",alt2);
		printk("\n");

		k_sleep(1000);

	}
	
}
```
